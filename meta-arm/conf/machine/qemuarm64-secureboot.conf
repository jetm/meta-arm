## meta-arm/conf/machine/qemuarm64-secureboot.conf
```bitbake
MACHINEOVERRIDES =. "qemuarm64:"

require ${COREBASE}/meta/conf/machine/qemuarm64.conf

KMACHINE = "qemuarm64"

# secure=on can't ever use KVM, so force it off
QEMU_USE_KVM = ""

QB_MACHINE = "-machine virt,secure=on,acpi=off"
QB_MEM = "-m 1024"
QB_DEFAULT_FSTYPE = "wic.qcow2"
QB_DEFAULT_BIOS = "flash.bin"
QB_FSINFO = "wic:no-kernel-in-fs"
QB_ROOTFS_OPT = ""

# kernel is in the image, should not be loaded separately
QB_DEFAULT_KERNEL = "none"

IMAGE_FSTYPES += "wic wic.qcow2"
KERNEL_IMAGETYPE = "Image"
IMAGE_BOOT_FILES = "${KERNEL_IMAGETYPE}"

WKS_FILE ?= "efi-disk-no-swap.wks.in"
WKS_FILE_DEPENDS = "trusted-firmware-a"

EFI_PROVIDER = "grub-efi"
IMAGE_INSTALL += "grub-efi"

MACHINE_FEATURES += "efi"
MACHINE_FEATURES += "uefi-secureboot"
MACHINE_FEATURES += "optee-ftpm"

INIT_MANAGER = "systemd"
IMAGE_INSTALL += "systemd util-linux bash coreutils efivar"

EXTRA_IMAGE_FEATURES += "empty-root-password allow-root-login"
```
